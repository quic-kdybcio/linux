// SPDX-License-Identifier: BSD-3-Clause
/*
 * Copyright (c) Qualcomm Technologies, Inc. and/or its subsidiaries.
 */

/dts-v1/;

#include "glymur-cob.dtsi"
#include "glymur-crd.dtsi"

/ {
	model = "Qualcomm Technologies, Inc. Glymur CRD";
	compatible = "qcom,glymur-crd", "qcom,glymur";
};

&pcie3_phy {
	vdda-phy-supply = <&vreg_l3c1>;
	vdda-pll-supply = <&vreg_l2c1>;

	vdda-refgen0p9-supply = <&vreg_l1c1>;
	vdda-refgen1p2-supply = <&vreg_l4f1>;
};
