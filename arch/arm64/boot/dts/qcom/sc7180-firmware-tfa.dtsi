// SPDX-License-Identifier: BSD-3-Clause

/*
 * Devices that use SC7180 with TrustedFirmware-A
 * need PSCI PC mode instead of the OSI mode provided
 * by Qualcomm firmware.
 */

&cluster_pd {
	domain-idle-states = <&cluster_sleep_0_tfa>;
};

&domain_idle_states {
	cluster_sleep_0_tfa: cluster-sleep-tfa-0 {
		compatible = "arm,idle-state";
		idle-state-name = "cluster-power-down";
		arm,psci-suspend-param = <0x40003444>;
		entry-latency-us = <3263>;
		exit-latency-us = <6562>;
		min-residency-us = <9926>;
		local-timer-stop;
	};
};

&apps_rsc {
	/delete-property/ power-domains;
};
